## board/pine64/soquartz-rk3566/Kconfig
```kconfig
if TARGET_SOQUARTZ_RK3566

config SYS_BOARD
	default "soquartz-rk3566"

config SYS_VENDOR
	default "pine64"

config SYS_CONFIG_NAME
	default "soquartz-rk3566"

config BOARD_SPECIFIC_OPTIONS # dummy
	def_bool y

endif
```
